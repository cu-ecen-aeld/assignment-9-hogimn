## base_external/configs/aesd_qemu_defconfig
```kconfig
# Reference https://github.com/buildroot/buildroot/blob/master/configs/qemu_aarch64_virt_defconfig

# Architecture

## Enable the ARMv8 AArch64 architecture for the build
BR2_aarch64=y

# System

## Use DHCP to configure the network interface
BR2_SYSTEM_DHCP="eth0"

# Filesystem

## Build the target root filesystem in ext2/4 format
BR2_TARGET_ROOTFS_EXT2=y
BR2_TARGET_ROOTFS_EXT2_4=y
## BR2_TARGET_ROOTFS_TAR is not set

# Image

## Run the post-image script after building the root filesystem
BR2_ROOTFS_POST_IMAGE_SCRIPT="board/qemu/post-image.sh"

## Pass the BR2_DEFCONFIG value to the post-image script
BR2_ROOTFS_POST_SCRIPT_ARGS="$(BR2_DEFCONFIG)"

# Linux headers same as kernel

## Enable the use of custom Linux kernel headers version 5.15 for the host system
BR2_PACKAGE_HOST_LINUX_HEADERS_CUSTOM_5_15=y

# Kernel

## Enable building the Linux kernel
BR2_LINUX_KERNEL=y

## Use a custom version of the Linux kernel
BR2_LINUX_KERNEL_CUSTOM_VERSION=y

## Specifies the version of the custom Linux kernel that will be used in the Buildroot project
BR2_LINUX_KERNEL_CUSTOM_VERSION_VALUE="5.15.18"

## Enables the use of a custom kernel configuration file for building the Linux kernel
BR2_LINUX_KERNEL_USE_CUSTOM_CONFIG=y

## Specifies the location of the custom Linux kernel configuration file
BR2_LINUX_KERNEL_CUSTOM_CONFIG_FILE="../base_external/configs/linux.config"

## Require OpenSSL to be installed on the host system for building the Linux kernel
BR2_LINUX_KERNEL_NEEDS_HOST_OPENSSL=y

# host-qemu for gitlab testing

## Enable building QEMU for the host system
BR2_PACKAGE_HOST_QEMU=y
## Enable system mode for QEMU on the host system
BR2_PACKAGE_HOST_QEMU_SYSTEM_MODE=y

# assignment-4-part-2 specific

## Enable building the AESD assignments
BR2_PACKAGE_AESD_ASSIGNMENTS=y

## Enable Dropbear for SSH access to the target system
BR2_PACKAGE_DROPBEAR=y

## Set the root password for the target filesystem
BR2_TARGET_GENERIC_ROOT_PASSWD="root"

## Enable the ccache tool for caching build artifacts
BR2_CCACHE=y

# assignment-7-part-2 specific

## Enable building LDD
BR2_PACKAGE_LDD=y

## Add custom files, directories, or symbolic links to the root filesystem image.
BR2_ROOTFS_OVERLAY="$(BR2_EXTERNAL_project_base_PATH)/rootfs_overlay"

# assignment-8 specific

## Enable building aesd-char-driver
BR2_PACKAGE_AESD_CHAR_DRIVER=y
```
